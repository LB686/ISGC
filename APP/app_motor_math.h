/**
 * @brief    电机控制数学工具库
 * @file     app_motor_math.h
 * @details  包含FOC所需的快速sin/cos/atan2、SVPWM、Clark/Park变换及通用数学工具。
 *           核心算法（sin/cos/atan2/SVPWM/Clark/Park）与 VESC 源码一致。
 *           工具函数从 VESC utils.c/h 移植，统一 MOTOR_ 前缀命名。
 * @author   LB
 * @version  V2.0
 * @date     2026/04/27
 * @license  Copyright (c) 2024-2026 浙江华奕航空科技有限公司.All rights reserved.
 */

#ifndef __APP_MOTOR_MATH_H__
#define __APP_MOTOR_MATH_H__

#include <stdint.h>
#include <stdbool.h>
#include <math.h>

/* =======================================================================================================
 *  第一节：通用数学宏定义（移植自 VESC utils.h，统一 MOTOR_ 前缀）
 * ======================================================================================================= */

/* 符号函数：负数返回-1.0，零或正数返回1.0 */
#define MOTOR_SIGN(x)               (((x) < 0.0f) ? -1.0f : 1.0f)

/* 平方 */
#define MOTOR_SQ(x)                 ((x) * (x))

/* 二维向量模长（使用 sqrtf，与 VESC NORM2_f 一致） */
#define MOTOR_NORM2(x, y)           (sqrtf(MOTOR_SQ(x) + MOTOR_SQ(y)))

/* NaN检查与清零（与 VESC UTILS_NAN_ZERO 一致） */
#define MOTOR_IS_NAN(x)             ((x) != (x))
#define MOTOR_NAN_ZERO(x)           (x = MOTOR_IS_NAN(x) ? 0.0f : x)

/* 一阶低通滤波器（与 VESC UTILS_LP_FAST 一致） */
#define MOTOR_LP_FAST(value, sample, fc)    (value -= (fc) * ((value) - (sample)))

/* 一阶低通近似移动平均（与 VESC UTILS_LP_MOVING_AVG_APPROX 一致） */
#define MOTOR_LP_MOVING_AVG_APPROX(value, sample, N)   MOTOR_LP_FAST(value, sample, 2.0f / ((N) + 1.0f))

/* SVPWM与常用常量（与 VESC 一致） */
#define MOTOR_ONE_BY_SQRT3          (0.57735026919f)
#define MOTOR_TWO_BY_SQRT3          (1.15470053838f)
#define MOTOR_SQRT3_BY_2            (0.86602540378f)
#define MOTOR_COS_30_DEG            (0.86602540378f)
#define MOTOR_SIN_30_DEG            (0.5f)
#define MOTOR_COS_MINUS_30_DEG      (0.86602540378f)
#define MOTOR_SIN_MINUS_30_DEG      (-0.5f)
#define MOTOR_ONE_BY_SQRT2          (0.7071067811865475f)

/* =======================================================================================================
 *  第二节：核心数学函数声明（算法与 VESC 一致）
 * ======================================================================================================= */

/*
*********************************************************************************************************
*   函 数 名: MOTOR_SincosBetter
*   功能说明: 快速正弦/余弦计算（抛物线逼近+二次校正，精度约0.001）
*   形    参: angle: 输入角度，单位弧度。范围不限，内部自动归一化到 -π~+π
*             sin:   输出正弦值指针
*             cos:   输出余弦值指针
*   返 回 值: 无
*   说    明: 对应 VESC utils_fast_sincos_better，比标准库 sinf/cosf 快约5~10倍
*********************************************************************************************************
*/
void MOTOR_SincosBetter(float angle, float *sin, float *cos);

/*
*********************************************************************************************************
*   函 数 名: MOTOR_Atan2
*   功能说明: 快速 atan2 计算（归一化多项式逼近，精度约0.01弧度）
*   形    参: y: 对边
*             x: 邻边
*   返 回 值: 角度，单位弧度，范围 -π~+π
*   说    明: 对应 VESC utils_fast_atan2
*********************************************************************************************************
*/
float MOTOR_Atan2(float y, float x);

/*
*********************************************************************************************************
*   函 数 名: MOTOR_SVM
*   功能说明: 7段式对称 SVPWM 空间矢量调制
*   形    参: alpha:  归一化电压 Vα（范围约 -1.0 ~ +1.0）
*             beta:   归一化电压 Vβ（范围约 -1.0 ~ +1.0）
*             maxMod: 最大调制比限制（如0.95）
*             pwmArr: PWM计数器峰值（ARR值，如4199）
*             tAout:  输出A相PWM计数值指针
*             tBout:  输出B相PWM计数值指针
*             tCout:  输出C相PWM计数值指针
*             sector: 输出扇区号指针（1~6，调试用）
*   返 回 值: 无
*   说    明: 对应 VESC foc_svm
*********************************************************************************************************
*/
void MOTOR_SVM(float alpha, float beta, float maxMod, uint32_t pwmArr,
               uint32_t *tAout, uint32_t *tBout, uint32_t *tCout, uint32_t *sector);

/* =======================================================================================================
 *  第三节：FOC坐标变换函数声明（算法与 VESC 一致）
 * ======================================================================================================= */

/*
*********************************************************************************************************
*   函 数 名: MOTOR_Clarke
*   功能说明: 等幅值 Clark 变换（三相静止 → 两相静止）
*   形    参: ia:     A相电流
*             ib:     B相电流
*             ialpha: 输出 Iα 指针
*             ibeta:  输出 Iβ 指针
*   返 回 值: 无
*   说    明: 对应 VESC 简化 Clark: Iα = Ia, Iβ = (Ia + 2*Ib) / √3
*********************************************************************************************************
*/
void MOTOR_Clarke(float ia, float ib, float *ialpha, float *ibeta);

/*
*********************************************************************************************************
*   函 数 名: MOTOR_Park
*   功能说明: Park 变换（两相静止 → 两相旋转）
*   形    参: ialpha: 输入 Iα
*             ibeta:  输入 Iβ
*             theta:  电角度，单位弧度
*             id:     输出 Id 指针
*             iq:     输出 Iq 指针
*   返 回 值: 无
*   说    明: 对应 VESC Park: Id = Iα*cosθ + Iβ*sinθ; Iq = Iβ*cosθ - Iα*sinθ
*********************************************************************************************************
*/
void MOTOR_Park(float ialpha, float ibeta, float theta, float *id, float *iq);

/*
*********************************************************************************************************
*   函 数 名: MOTOR_InvPark
*   功能说明: 反 Park 变换（两相旋转 → 两相静止）
*   形    参: vd:     输入 Vd
*             vq:     输入 Vq
*             theta:  电角度，单位弧度
*             valpha: 输出 Vα 指针
*             vbeta:  输出 Vβ 指针
*   返 回 值: 无
*   说    明: 对应 VESC InvPark: Vα = Vd*cosθ - Vq*sinθ; Vβ = Vd*sinθ + Vq*cosθ
*********************************************************************************************************
*/
void MOTOR_InvPark(float vd, float vq, float theta, float *valpha, float *vbeta);

/* =======================================================================================================
 *  第四节：通用工具内联函数（移植自 VESC utils.h）
 * ======================================================================================================= */

/*
*********************************************************************************************************
*   函 数 名: MOTOR_Truncate
*   功能说明: 浮点限幅（与 VESC utils_truncate_number 一致）
*********************************************************************************************************
*/
static inline void MOTOR_Truncate(float *number, float min, float max) {
    if (*number > max) {
        *number = max;
    } else if (*number < min) {
        *number = min;
    }
}

/*
*********************************************************************************************************
*   函 数 名: MOTOR_TruncateAbs
*   功能说明: 浮点对称限幅（与 VESC utils_truncate_number_abs 一致）
*********************************************************************************************************
*/
static inline void MOTOR_TruncateAbs(float *number, float max) {
    if (*number > max) {
        *number = max;
    } else if (*number < -max) {
        *number = -max;
    }
}

/*
*********************************************************************************************************
*   函 数 名: MOTOR_NormAngleRad
*   功能说明: 角度归一化到 [-π, +π)（与 VESC utils_norm_angle_rad 一致）
*********************************************************************************************************
*/
static inline void MOTOR_NormAngleRad(float *angle) {
    while (*angle < -M_PI) { *angle += 2.0f * M_PI; }
    while (*angle >=  M_PI) { *angle -= 2.0f * M_PI; }
}

/*
*********************************************************************************************************
*   函 数 名: MOTOR_StepTowards
*   功能说明: 向目标值步进，单次变化量不超过 step（与 VESC utils_step_towards 一致）
*   形    参: value: 当前值指针
*             goal:  目标值
*             step:  最大步长（正数）
*   返 回 值: 无
*********************************************************************************************************
*/
static inline void MOTOR_StepTowards(float *value, float goal, float step) {
    if (*value < goal) {
        if ((*value + step) < goal) {
            *value += step;
        } else {
            *value = goal;
        }
    } else if (*value > goal) {
        if ((*value - step) > goal) {
            *value -= step;
        } else {
            *value = goal;
        }
    }
}

/*
*********************************************************************************************************
*   函 数 名: MOTOR_Map
*   功能说明: 线性映射（与 VESC utils_map 一致）
*********************************************************************************************************
*/
static inline float MOTOR_Map(float x, float in_min, float in_max, float out_min, float out_max) {
    return (x - in_min) * (out_max - out_min) / (in_max - in_min) + out_min;
}

/*
*********************************************************************************************************
*   函 数 名: MOTOR_SaturateVector2D
*   功能说明: 二维向量圆限幅（与 VESC utils_saturate_vector_2d 一致）
*   形    参: x, y: 向量分量指针
*             max:  最大模长
*   返 回 值: true: 发生了限幅; false: 未限幅
*********************************************************************************************************
*/
static inline bool MOTOR_SaturateVector2D(float *x, float *y, float max) {
    bool retval = false;
    float mag = MOTOR_NORM2(*x, *y);
    max = fabsf(max);
    if (mag < 1e-10f) {
        mag = 1e-10f;
    }
    if (mag > max) {
        const float f = max / mag;
        *x *= f;
        *y *= f;
        retval = true;
    }
    return retval;
}

/* =======================================================================================================
 *  第五节：通用工具函数声明（移植自 VESC utils.c）
 * ======================================================================================================= */

/*
*********************************************************************************************************
*   函 数 名: MOTOR_AngleDifferenceRad
*   功能说明: 计算两弧度角度的差值，结果限定在 [-π, +π]
*   说    明: 移植自 VESC utils_angle_difference_rad
*********************************************************************************************************
*/
float MOTOR_AngleDifferenceRad(float angle1, float angle2);

/*
*********************************************************************************************************
*   函 数 名: MOTOR_Deadband
*   功能说明: 死区处理：绝对值小于阈值时输出置零
*   说    明: 移植自 VESC utils_deadband，常用于油门/指令死区
*********************************************************************************************************
*/
void MOTOR_Deadband(float *value, float tres, float max);

/*
*********************************************************************************************************
*   函 数 名: MOTOR_MiddleOf3
*   功能说明: 取三个浮点数的中间值（三取中滤波）
*   说    明: 移植自 VESC utils_middle_of_3，可用于电流采样故障容错
*********************************************************************************************************
*/
float MOTOR_MiddleOf3(float a, float b, float c);

/*
*********************************************************************************************************
*   函 数 名: MOTOR_MiddleOf3Int
*   功能说明: 取三个整数的中间值
*   说    明: 移植自 VESC utils_middle_of_3_int
*********************************************************************************************************
*/
int MOTOR_MiddleOf3Int(int a, int b, int c);

/*
*********************************************************************************************************
*   函 数 名: MOTOR_MinAbs
*   功能说明: 返回绝对值较小的那个数
*   说    明: 移植自 VESC utils_min_abs
*********************************************************************************************************
*/
float MOTOR_MinAbs(float va, float vb);

/*
*********************************************************************************************************
*   函 数 名: MOTOR_MaxAbs
*   功能说明: 返回绝对值较大的那个数
*   说    明: 移植自 VESC utils_max_abs
*********************************************************************************************************
*/
float MOTOR_MaxAbs(float va, float vb);

#endif /* __APP_MOTOR_MATH_H__ */
